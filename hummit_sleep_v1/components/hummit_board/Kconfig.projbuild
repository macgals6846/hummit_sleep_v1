## hummit_sleep_v1/components/hummit_board/Kconfig.projbuild
```kconfig
menu "Hummit Board"

choice CUSTOMER_AUDIO_BOARD
    prompt "Hummit board"
    default MY_BOARD_V1_0
    help
        Select an audio board to use with the ESP-ADF

config MY_BOARD_V1_0
    bool "Hummit board v1.0"

endchoice

endmenu
```
